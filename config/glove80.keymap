/* source keypos definitions */
#include "../zmk-nodefree-config/keypos_def/keypos_glv80.h"

/* map the Glove's extra keys */
#define X_LT  \
                &kp F1    &kp F2 &kp F3 &kp F4 &kp F5                 &kp F6 &kp F7 &kp F8 &kp F9 &kp F10 \
                &kp EQUAL &kp N1 &kp N2 &kp N3 &kp N4 &kp N5   &kp N6 &kp N7 &kp N8 &kp N9 &kp N0 &kp MINUS \
                &kp TAB
#define X_RT    &kp BACKSLASH

#define X_LM    &kp ESC
#define X_RM    &kp BSPC

#define X_LB    &kp LSHFT
#define X_MB    &kp LCTRL &kp LSHFT &kp LALT       &kp RALT &kp RSHFT &kp RCTRL
#define X_RB    &kp LSHFT

#define X_LH    &smart_mouse &kp GRAVE &kp BSLH &kp LEFT &kp RIGHT
#define X_MH    &kp LGUI &kp RGUI
#define X_RH    &kp UP &kp DOWN &kp LBKT &kp RBKT &kp FSLH

/* activate bluetooth */
#define CONFIG_WIRELESS 1

/* source the main keymap */
#include "base.keymap"

